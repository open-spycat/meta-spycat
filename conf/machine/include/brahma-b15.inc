## conf/machine/include/brahma-b15.inc
```bitbake
TARGET_ARCH = "arm"
DEFAULTTUNE = "armv7ahf-neon"

require conf/machine/include/arm/arch-armv7a.inc
```

## conf/machine/spycat.conf
```bitbake
#@TYPE: Machine
#@NAME: SPYCAT Spycat
#@DESCRIPTION: Machine configuration for the SPYCAT Spycat

CHIPSET = "bcm7362"

require conf/machine/include/bmips.inc
require conf/machine/include/build-extras.inc

MACHINE_ESSENTIAL_EXTRA_RDEPENDS += "spycat-dvb-modules-spycat"
MACHINE_ESSENTIAL_EXTRA_RDEPENDS += "spycat-rtl8723bs"
MACHINE_ESSENTIAL_EXTRA_RRECOMMENDS += "kernel-module-cdfs"
MACHINE_ESSENTIAL_EXTRA_RRECOMMENDS += "kernel-module-hci-uart"

MACHINE_EXTRA_RRECOMMENDS += "gst-plugin-dvbmediasink"

DVBMEDIASINK_CONFIG = "--with-wma --with-wmv --with-pcm --with-dts --with-eac3"

PREFERRED_PROVIDER_virtual/kernel = "linux-spycat"
PREFERRED_VERSION_linux-spycat= "4.9"

KERNEL_IMAGETYPE = "vmlinux"
KERNEL_OUTPUT = "${KERNEL_IMAGETYPE}"
KERNEL_OUTPUT_DIR = "."
KERNEL_CONSOLE = "ttyS0,115200n8"

KERNEL_MODULE_AUTOLOAD += "r8723bs"
KERNEL_MODULE_AUTOLOAD += "hci_uart"

MACHINE_FEATURES += "alsa wlan 3dtv switchoff osdposition hdmicec textlcd dvb-c ci"

require conf/machine/include/autoload-filesystems.inc
require conf/machine/include/rootfs-ubi.inc
```

## conf/machine/spycat4kmini.conf
```bitbake
#@TYPE: Machine
#@NAME: SPYCAT Spycat 4K mini
#@DESCRIPTION: Machine configuration for the SPYCAT Spycat 4K mini

CHIPSET = "bcm7251s"

require conf/machine/include/brahma-b15.inc
require conf/machine/include/build-extras.inc

MACHINE_ESSENTIAL_EXTRA_RDEPENDS += "spycat-dvb-modules-spycat4kmini"
MACHINE_ESSENTIAL_EXTRA_RDEPENDS += "spycat-rtl8723bs"
MACHINE_ESSENTIAL_EXTRA_RRECOMMENDS += "kernel-module-cdfs"
MACHINE_ESSENTIAL_EXTRA_RRECOMMENDS += "kernel-module-hci-uart"

MACHINE_EXTRA_RRECOMMENDS += "gst-plugin-dvbmediasink"

DVBMEDIASINK_CONFIG = "--with-wma --with-wmv --with-pcm --with-dts --with-eac3 --with-h265"

PREFERRED_PROVIDER_virtual/kernel = "linux-spycat"
PREFERRED_VERSION_linux-spycat = "4.10"

KERNEL_IMAGETYPE = "zImage"
KERNEL_CONSOLE = "ttyS0,115200n8"

KERNEL_MODULE_AUTOLOAD += "r8723bs"
KERNEL_MODULE_AUTOLOAD += "hci_uart"

MACHINE_FEATURES += "alsa wlan 3dtv switchoff osdposition hdmicec textlcd dvb-c"

require conf/machine/include/autoload-filesystems.inc
require conf/machine/include/rootfs-ubi.inc
```

## conf/machine/spycatminiplus.conf
```bitbake
#@TYPE: Machine
#@NAME: SPYCAT Spycatmini+
#@DESCRIPTION: Machine configuration for the SPYCAT Spycatmini+

CHIPSET = "bcm7362"

require conf/machine/include/bmips.inc
require conf/machine/include/build-extras.inc

MACHINE_ESSENTIAL_EXTRA_RDEPENDS += "spycat-dvb-modules-spycatminiplus"
MACHINE_ESSENTIAL_EXTRA_RDEPENDS += "spycat-rtl8723bs"
MACHINE_ESSENTIAL_EXTRA_RRECOMMENDS += "kernel-module-cdfs"
MACHINE_ESSENTIAL_EXTRA_RRECOMMENDS += "kernel-module-hci-uart"

MACHINE_EXTRA_RRECOMMENDS += "gst-plugin-dvbmediasink"

DVBMEDIASINK_CONFIG = "--with-wma --with-wmv --with-pcm --with-dts --with-eac3 --with-h265"

PREFERRED_PROVIDER_virtual/kernel = "linux-spycat"
PREFERRED_VERSION_linux-spycat = "4.10"

KERNEL_IMAGETYPE = "vmlinux.gz"
KERNEL_CONSOLE = "ttyS0,115200n8"

KERNEL_MODULE_AUTOLOAD += "r8723bs"
KERNEL_MODULE_AUTOLOAD += "hci_uart"

MACHINE_FEATURES += "alsa wlan 3dtv switchoff osdposition hdmicec textlcd dvb-c 7segment"

require conf/machine/include/autoload-filesystems.inc
require conf/machine/include/rootfs-ubi.inc
```
